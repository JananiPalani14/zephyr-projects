## asset_relay/build/Kconfig/arch/Kconfig
```kconfig
# Load Zephyr Arch Kconfig descriptions.
osource "/home/janani/ncs/v2.9.3/zephyr/arch/x86/Kconfig"
osource "/home/janani/ncs/v2.9.3/zephyr/arch/xtensa/Kconfig"
osource "/home/janani/ncs/v2.9.3/zephyr/arch/sparc/Kconfig"
osource "/home/janani/ncs/v2.9.3/zephyr/arch/riscv/Kconfig"
osource "/home/janani/ncs/v2.9.3/zephyr/arch/posix/Kconfig"
osource "/home/janani/ncs/v2.9.3/zephyr/arch/nios2/Kconfig"
osource "/home/janani/ncs/v2.9.3/zephyr/arch/mips/Kconfig"
osource "/home/janani/ncs/v2.9.3/zephyr/arch/arm64/Kconfig"
osource "/home/janani/ncs/v2.9.3/zephyr/arch/arm/Kconfig"
osource "/home/janani/ncs/v2.9.3/zephyr/arch/arc/Kconfig"
```

## asset_relay/build/Kconfig/boards/Kconfig.nrf52833dk
```kconfig
# Load board Kconfig descriptions.
osource "/home/janani/ncs/v2.9.3/zephyr/boards/nordic/nrf52833dk/Kconfig.nrf52833dk"
```
